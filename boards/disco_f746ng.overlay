/*
 * Copyright (c) 2023 Your Name
 *
 * SPDX-License-Identifier: Apache-2.0
 */

/ {
    aliases {
        led0 = &green_led_1;
    };

    leds {
        compatible = "gpio-leds";
        green_led_1: led_1 {
            gpios = <&gpioi 1 GPIO_ACTIVE_HIGH>;
            label = "User LD1";
        };
    };
}; 